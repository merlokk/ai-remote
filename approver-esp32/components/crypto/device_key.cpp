#include "device_key.h"

#include <cstring>

#include "bootloader_random.h"
#include "esp_efuse.h"
#include "esp_hmac.h"
#include "esp_log.h"
#include "esp_random.h"
#include "nvs.h"
#include "nvs_flash.h"
#include "sodium.h"

namespace crypto {
namespace {

constexpr const char *TAG = "crypto";

// --- The self-test vector (CLAUDE.md §10.6) ---------------------------------
// **Generated by `lib/crypto.py`, not typed from a datasheet or copied out of a
// specification.** The command that produced it is in `working-with-code.md`;
// the seed is `00 01 02 … 1f` so that it is obviously a test key and not
// something anybody could mistake for an identity.
//
// It is one vector doing two jobs, which is what §10.6 asks of it: `kSignature`
// is the answer this device must produce for `kMessage`, *and* it is a
// Python-made signature that this device's verify has to accept. A library that
// signs correctly but verifies nothing would pass half of this.
//
// §10.11 tier 2 will generalise this into a fixture set covering the whole of
// §7; until then this is the one vector, and it is enough to catch the failure
// this test exists for — a crypto library that is silently wrong.
constexpr uint8_t kTestSeed[kSeedSize] = {
    0x00, 0x01, 0x02, 0x03, 0x04, 0x05, 0x06, 0x07, 0x08, 0x09, 0x0a,
    0x0b, 0x0c, 0x0d, 0x0e, 0x0f, 0x10, 0x11, 0x12, 0x13, 0x14, 0x15,
    0x16, 0x17, 0x18, 0x19, 0x1a, 0x1b, 0x1c, 0x1d, 0x1e, 0x1f,
};

constexpr uint8_t kTestPublicKey[kPublicKeySize] = {
    0x03, 0xa1, 0x07, 0xbf, 0xf3, 0xce, 0x10, 0xbe, 0x1d, 0x70, 0xdd,
    0x18, 0xe7, 0x4b, 0xc0, 0x99, 0x67, 0xe4, 0xd6, 0x30, 0x9b, 0xa5,
    0x0d, 0x5f, 0x1d, 0xdc, 0x86, 0x64, 0x12, 0x55, 0x31, 0xb8,
};

constexpr char kTestMessage[] = "ai-remote approver-esp32 libsodium self-test v1";

constexpr uint8_t kTestSignature[kSignatureSize] = {
    0x04, 0x0c, 0xd4, 0xd8, 0xbc, 0x9e, 0x8c, 0x43, 0x6f, 0x0b, 0x59, 0xe4, 0x20,
    0xf1, 0xd2, 0x7c, 0x1a, 0x4a, 0x3f, 0x7d, 0x12, 0x48, 0x63, 0xd9, 0xa4, 0x67,
    0xe3, 0xa4, 0xfc, 0xc0, 0xa4, 0x95, 0x04, 0x83, 0x79, 0x24, 0x4d, 0x03, 0xf5,
    0xd1, 0xc2, 0xa3, 0x14, 0xa0, 0xf5, 0xe6, 0x04, 0x23, 0x95, 0x3a, 0xb5, 0xf4,
    0x08, 0xa5, 0x52, 0xa1, 0x13, 0xe2, 0x4b, 0xd3, 0x93, 0x01, 0xbf, 0x09,
};

// --- The identity -----------------------------------------------------------
// Static, and therefore in `.bss` rather than on any heap (§10.14.1). "RAM only"
// in §10.6's sense means exactly this: it is never written to flash, and there
// is no file to steal.
KeyState g_state = KeyState::kUninitialised;
KeySource g_source = KeySource::kNone;
int g_block = -1;

uint8_t g_public[kPublicKeySize];
uint8_t g_secret[kSecretKeySize];
char g_public_b64[kPublicKeyB64Size];

bool g_sodium_ready = false;

bool EnsureSodium() {
    if (g_sodium_ready) {
        return true;
    }
    // 0 is "initialised", 1 is "already initialised by somebody else", and only
    // -1 is a failure. Treating 1 as an error is the classic misread.
    if (sodium_init() < 0) {
        ESP_LOGE(TAG, "libsodium would not initialise");
        return false;
    }
    g_sodium_ready = true;
    return true;
}

// **The one place the eFuse is looked at.** `esp_efuse_find_purpose` answers
// which block, if any, was burned to be usable by the HMAC peripheral and by
// nothing else; the HMAC key id is that block's offset from the first key block.
//
// Nothing here burns anything. Burning is a one-way operation performed from the
// host with `espefuse.py`, deliberately outside the firmware — a device that can
// permanently alter its own fuses is a device one bad boot away from being a
// different responder.
bool FindHmacKey(hmac_key_id_t *key_id, int *block_index) {
    esp_efuse_block_t block = EFUSE_BLK_KEY0;
    if (!esp_efuse_find_purpose(ESP_EFUSE_KEY_PURPOSE_HMAC_UP, &block)) {
        return false;
    }
    const int index = static_cast<int>(block) - static_cast<int>(EFUSE_BLK_KEY0);
    if (index < 0 || index > static_cast<int>(HMAC_KEY5)) {
        return false;
    }
    *key_id = static_cast<hmac_key_id_t>(index);
    *block_index = index;
    return true;
}

// --- Route 2: the seed in NVS (§10.6's fallback, §10.15) ---------------------
// **The one namespace this firmware puts in NVS**, and §10.15's "nothing of ours
// in NVS" now has exactly one exception with exactly one reason. It is here
// rather than in `config.json` because a seed is not a setting: it must not be
// restored by §10.15's button, must not appear in `cat config.json`, and must
// not be edited by hand.
constexpr const char *kNvsNamespace = "approver";
constexpr const char *kNvsSeedKey = "seed";

// NVS is initialised here as well as in the radio (§10.9), because this runs
// first and neither may assume the other has. `nvs_flash_init` is idempotent, so
// the second caller costs nothing.
bool EnsureNvs() {
    esp_err_t err = nvs_flash_init();
    if (err == ESP_ERR_NVS_NO_FREE_PAGES || err == ESP_ERR_NVS_NEW_VERSION_FOUND) {
        ESP_LOGW(TAG, "nvs needs erasing");
        if (nvs_flash_erase() == ESP_OK) {
            err = nvs_flash_init();
        }
    }
    if (err != ESP_OK) {
        ESP_LOGE(TAG, "nvs_flash_init: %s", esp_err_to_name(err));
        return false;
    }
    return true;
}

// **Exactly 32 bytes or nothing.** A blob of some other length is not a seed this
// firmware wrote, and deriving a key from a truncated one would give a device
// that signs with something nobody can reproduce. Refusing sends it down the
// generate path, which makes a good one.
bool LoadSeed(uint8_t *seed) {
    nvs_handle_t handle = 0;
    if (nvs_open(kNvsNamespace, NVS_READONLY, &handle) != ESP_OK) {
        return false;
    }
    size_t length = 0;
    bool ok = nvs_get_blob(handle, kNvsSeedKey, nullptr, &length) == ESP_OK && length == kSeedSize;
    ok = ok && nvs_get_blob(handle, kNvsSeedKey, seed, &length) == ESP_OK;
    nvs_close(handle);
    if (!ok) {
        sodium_memzero(seed, kSeedSize);
    }
    return ok;
}

bool StoreSeed(const uint8_t *seed) {
    nvs_handle_t handle = 0;
    if (nvs_open(kNvsNamespace, NVS_READWRITE, &handle) != ESP_OK) {
        return false;
    }
    bool ok = nvs_set_blob(handle, kNvsSeedKey, seed, kSeedSize) == ESP_OK;
    ok = ok && nvs_commit(handle) == ESP_OK;
    nvs_close(handle);
    return ok;
}

// **True randomness without the radio, for the one call that needs it.** The RNG
// on this chip is only a true random source while the RF subsystem or the SAR-ADC
// entropy source is running; at this point in the boot neither is, so a plain
// `esp_fill_random` would hand back a PRNG stream — and a predictable seed is an
// identity anybody can recompute, which is the whole property this key is for.
//
// `bootloader_random_enable` is the documented way to have it early, and its one
// rule is that it must be switched off again before anything touches the ADC or
// the radio. Both are later in `main.cpp` than this, and the source is on for the
// length of one 32-byte read.
void FillRandomSeed(uint8_t *seed) {
    bootloader_random_enable();
    esp_fill_random(seed, kSeedSize);
    bootloader_random_disable();
}

// Returns false only when a seed could neither be read nor made to survive a
// reboot. **A seed that cannot be stored is refused rather than used**: a device
// whose identity changes on every boot would register successfully and then be
// rejected on the next power cycle, which is a worse failure than not having a
// key at all — the operator would be debugging the handler.
bool LoadOrCreateSeed(uint8_t *seed) {
    if (!EnsureNvs()) {
        return false;
    }
    if (LoadSeed(seed)) {
        return true;
    }

    FillRandomSeed(seed);
    if (!StoreSeed(seed)) {
        sodium_memzero(seed, kSeedSize);
        ESP_LOGE(TAG, "a new key was made and could not be saved - refusing to use it");
        return false;
    }
    ESP_LOGW(TAG, "made a new signing key and saved it - this device is a new responder");
    return true;
}

}  // namespace

bool SelfTest() {
    if (!EnsureSodium()) {
        return false;
    }

    uint8_t pub[kPublicKeySize];
    uint8_t secret[kSecretKeySize];
    uint8_t signature[kSignatureSize];

    bool ok = crypto_sign_seed_keypair(pub, secret, kTestSeed) == 0;
    ok = ok && std::memcmp(pub, kTestPublicKey, sizeof pub) == 0;

    ok = ok && crypto_sign_detached(signature, nullptr,
                                    reinterpret_cast<const uint8_t *>(kTestMessage),
                                    sizeof(kTestMessage) - 1, secret) == 0;
    ok = ok && std::memcmp(signature, kTestSignature, sizeof signature) == 0;

    // The other half: a signature Python made, checked here. Signing correctly
    // and verifying nothing would otherwise pass.
    ok = ok && crypto_sign_verify_detached(kTestSignature,
                                           reinterpret_cast<const uint8_t *>(kTestMessage),
                                           sizeof(kTestMessage) - 1, kTestPublicKey) == 0;

    // And a signature that must **not** verify, because a verify that says yes
    // to everything also passes the line above. One flipped bit is the smallest
    // difference the scheme is allowed to miss, which makes it the right one.
    uint8_t tampered[kSignatureSize];
    std::memcpy(tampered, kTestSignature, sizeof tampered);
    tampered[0] ^= 0x01;
    ok = ok && crypto_sign_verify_detached(tampered,
                                           reinterpret_cast<const uint8_t *>(kTestMessage),
                                           sizeof(kTestMessage) - 1, kTestPublicKey) != 0;

    sodium_memzero(secret, sizeof secret);
    return ok;
}

esp_err_t Init() {
    if (g_state != KeyState::kUninitialised) {
        return g_state == KeyState::kReady ? ESP_OK : ESP_ERR_INVALID_STATE;
    }

    if (!EnsureSodium()) {
        g_state = KeyState::kSelfTestFailed;
        return ESP_FAIL;
    }

    // **The self-test comes first, and a failure stops everything.** Deriving an
    // identity from a library that cannot be trusted to sign would produce a
    // device that looks registered and is rejected on every reply — the exact
    // silent failure §10.6 is written to prevent.
    if (!SelfTest()) {
        g_state = KeyState::kSelfTestFailed;
        ESP_LOGE(TAG, "self-test failed: this build's Ed25519 does not match the host's");
        return ESP_FAIL;
    }
    ESP_LOGI(TAG, "self-test passed");

    uint8_t seed[kSeedSize];

    // **Route 1 is tried first, always** — so a board that gets a key burned into
    // it later picks it up on the next boot with no firmware change. The cost of
    // that is a changed identity, and it is said rather than smoothed over.
    hmac_key_id_t key_id = HMAC_KEY0;
    if (FindHmacKey(&key_id, &g_block)) {
        const esp_err_t err = esp_hmac_calculate(key_id, kKeyLabel, sizeof(kKeyLabel) - 1, seed);
        if (err != ESP_OK) {
            sodium_memzero(seed, sizeof seed);
            g_state = KeyState::kHmacFailed;
            // The block is named **before** it is cleared. Logging it afterwards
            // prints `-1`, which is a line that sends somebody hunting for a key
            // block that does not exist rather than looking at the one that
            // refused.
            ESP_LOGE(TAG, "the HMAC unit refused key block %d: %s", g_block, esp_err_to_name(err));
            g_block = -1;
            return err;
        }
        g_source = KeySource::kEfuse;

        // And the fallback's seed, if this board was running on one, is now dead
        // weight: it can never be used again, and the whole cost of route 2 is a
        // private key sitting in flash. Deleting it is the one thing that stops
        // paying that cost.
        if (EnsureNvs()) {
            uint8_t stale[kSeedSize];
            if (LoadSeed(stale)) {
                sodium_memzero(stale, sizeof stale);
                ForgetStoredSeed();
                ESP_LOGW(TAG,
                         "a chip key is burned now, so the saved one was dropped - this device is "
                         "a different responder and needs registering again");
            }
        }
    } else {
        // **Route 2**, and the log line says which one shipped because §10.6
        // requires that the answer be visible rather than inferred.
        if (!LoadOrCreateSeed(seed)) {
            g_state = KeyState::kNoSeed;
            g_block = -1;
            return ESP_ERR_NOT_FOUND;
        }
        g_source = KeySource::kStoredSeed;
        g_block = -1;
    }

    const int rc = crypto_sign_seed_keypair(g_public, g_secret, seed);

    // **The seed goes as soon as the key is derived.** On route 1 it exists
    // nowhere afterwards, which was the point. On route 2 it is still in flash —
    // clearing the copy in RAM does not change that, and pretending otherwise is
    // exactly what this file refuses to do.
    sodium_memzero(seed, sizeof seed);

    if (rc != 0) {
        sodium_memzero(g_secret, sizeof g_secret);
        g_state = KeyState::kNoSeed;
        g_source = KeySource::kNone;
        return ESP_FAIL;
    }

    Base64Encode(g_public, sizeof g_public, g_public_b64, sizeof g_public_b64);
    g_state = KeyState::kReady;

    // The public half is not a secret and is the string §10.7 has an operator
    // compare by eye, so it is logged deliberately. The private half appears in
    // no log line anywhere, which is the rule §10.15 states about passwords
    // applied to the one value on this device that matters more.
    ESP_LOGI(TAG, "key ready (%s), public key %s", SourceText(), g_public_b64);
    if (KeyIsInFlash()) {
        ESP_LOGW(TAG,
                 "the signing key is stored in flash and can be read out of it - this is the "
                 "fallback, not the design");
    }
    return ESP_OK;
}

bool ProveKey(char *out, size_t out_size) {
    if (!Ready() || out == nullptr) {
        return false;
    }
    uint8_t signature[kSignatureSize];
    if (Sign(reinterpret_cast<const uint8_t *>(kProofMessage), sizeof(kProofMessage) - 1,
             signature) != ESP_OK) {
        return false;
    }
    // Checked here as well as printed, so a failure is caught on the device
    // rather than only by whoever compares the string afterwards. This is the
    // pairing the self-test cannot see: a public key that does not belong to the
    // private one signs happily and verifies against nothing.
    if (!Verify(g_public, reinterpret_cast<const uint8_t *>(kProofMessage),
                sizeof(kProofMessage) - 1, signature)) {
        return false;
    }
    return Base64Encode(signature, sizeof signature, out, out_size);
}

esp_err_t ForgetStoredSeed() {
    if (!EnsureNvs()) {
        return ESP_FAIL;
    }
    nvs_handle_t handle = 0;
    esp_err_t err = nvs_open(kNvsNamespace, NVS_READWRITE, &handle);
    if (err != ESP_OK) {
        return err;
    }
    err = nvs_erase_key(handle, kNvsSeedKey);
    if (err == ESP_OK) {
        err = nvs_commit(handle);
    } else if (err == ESP_ERR_NVS_NOT_FOUND) {
        // Nothing to forget is not a failure. It is the ordinary state of a board
        // on route 1.
        err = ESP_OK;
    }
    nvs_close(handle);
    return err;
}

KeyState State() { return g_state; }

KeySource Source() { return g_source; }

bool Ready() { return g_state == KeyState::kReady; }

bool KeyIsInFlash() { return g_source == KeySource::kStoredSeed; }

const char *StateText() {
    switch (g_state) {
        case KeyState::kUninitialised:
            return "not started";
        case KeyState::kSelfTestFailed:
            return "self-test failed - the signature would not be trusted";
        case KeyState::kHmacFailed:
            return "the chip refused to use its key";
        case KeyState::kNoSeed:
            return "no key, and none could be saved - it cannot sign";
        case KeyState::kReady:
            return "ready";
    }
    return "unknown";
}

const char *SourceText() {
    switch (g_source) {
        case KeySource::kNone:
            return "nowhere";
        case KeySource::kEfuse:
            // The block number is the caller's to add - this string has to be
            // usable without knowing it.
            return "derived from a chip key, nothing stored";
        case KeySource::kStoredSeed:
            return "a saved key, readable from a flash dump";
    }
    return "unknown";
}

const uint8_t *PublicKey() { return g_public; }

const char *PublicKeyBase64() { return Ready() ? g_public_b64 : ""; }

int EfuseBlock() { return g_block; }

esp_err_t Sign(const uint8_t *message, size_t length, uint8_t out[kSignatureSize]) {
    if (!Ready()) {
        return ESP_ERR_INVALID_STATE;
    }
    if (message == nullptr || out == nullptr) {
        return ESP_ERR_INVALID_ARG;
    }
    return crypto_sign_detached(out, nullptr, message, length, g_secret) == 0 ? ESP_OK : ESP_FAIL;
}

bool Verify(const uint8_t public_key[kPublicKeySize], const uint8_t *message, size_t length,
            const uint8_t signature[kSignatureSize]) {
    if (!EnsureSodium() || public_key == nullptr || message == nullptr || signature == nullptr) {
        return false;
    }
    return crypto_sign_verify_detached(signature, message, length, public_key) == 0;
}

bool Base64Encode(const uint8_t *data, size_t length, char *out, size_t out_size) {
    if (data == nullptr || out == nullptr) {
        return false;
    }
    if (out_size < sodium_base64_ENCODED_LEN(length, sodium_base64_VARIANT_ORIGINAL)) {
        return false;
    }
    sodium_bin2base64(out, out_size, data, length, sodium_base64_VARIANT_ORIGINAL);
    return true;
}

size_t Base64Decode(const char *text, uint8_t *out, size_t out_size) {
    if (text == nullptr || out == nullptr) {
        return 0;
    }
    size_t written = 0;
    if (sodium_base642bin(out, out_size, text, std::strlen(text), nullptr, &written, nullptr,
                          sodium_base64_VARIANT_ORIGINAL) != 0) {
        return 0;
    }
    return written;
}

}  // namespace crypto
