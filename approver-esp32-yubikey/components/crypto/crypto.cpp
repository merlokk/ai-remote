#include "crypto.h"

#include <cstring>

#include "esp_log.h"
#include "nvs.h"
#include "nvs_flash.h"
#include "sodium.h"

// Generated by `approver-esp32/tools/make_vectors.py` (§10.11 tier 2). **Its
// `kSelfTestSeed` is unused here** and stays in the file rather than being
// stripped out of it: the generator is the sibling board's, that board still signs,
// and a vector header that differs between the two would be a second thing to keep
// in step for no gain.
#include "selftest_vector.h"

namespace crypto {
namespace {

constexpr const char *TAG = "crypto";

// Where an older firmware kept the Ed25519 seed. Read once, to delete it.
constexpr const char *kNvsNamespace = "approver";
constexpr const char *kNvsSeedKey = "seed";

bool g_sodium_ready = false;
bool g_self_test_ok = false;

bool EnsureSodium() {
    if (g_sodium_ready) {
        return true;
    }
    // 0 is "initialised", 1 is "already initialised by somebody else", and only
    // -1 is a failure. Treating 1 as an error is the classic misread.
    if (sodium_init() < 0) {
        ESP_LOGE(TAG, "libsodium would not initialise");
        return false;
    }
    g_sodium_ready = true;
    return true;
}

// `nvs_flash_init` is idempotent and the Wi-Fi radio calls it too (§10.9) — either
// may run first and neither may assume the other has.
bool EnsureNvs() {
    esp_err_t err = nvs_flash_init();
    if (err == ESP_ERR_NVS_NO_FREE_PAGES || err == ESP_ERR_NVS_NEW_VERSION_FOUND) {
        if (nvs_flash_erase() == ESP_OK) {
            err = nvs_flash_init();
        }
    }
    if (err != ESP_OK) {
        ESP_LOGE(TAG, "nvs_flash_init: %s", esp_err_to_name(err));
        return false;
    }
    return true;
}

// **The point of the whole change, and it runs once per board.** Deleting the code
// that derived an identity leaves the seed it derived from exactly where it was —
// 32 bytes of private key in unencrypted NVS, now belonging to nothing. So the
// firmware that stops using it is also the firmware that removes it, and says so
// out loud the once: an operator who has been told this board holds no private key
// should be able to see the moment it stopped.
void EraseLegacySeed() {
    if (!EnsureNvs()) {
        return;
    }
    nvs_handle_t handle = 0;
    if (nvs_open(kNvsNamespace, NVS_READWRITE, &handle) != ESP_OK) {
        return;
    }
    size_t length = 0;
    if (nvs_get_blob(handle, kNvsSeedKey, nullptr, &length) == ESP_OK) {
        const esp_err_t err = nvs_erase_key(handle, kNvsSeedKey);
        if (err == ESP_OK && nvs_commit(handle) == ESP_OK) {
            ESP_LOGW(TAG,
                     "erased the %u-byte Ed25519 seed an older firmware stored - this board now "
                     "holds no private key at all (§10.6)",
                     static_cast<unsigned>(length));
        } else {
            // Worth a line rather than a silence: the promise this component makes
            // about what a flash dump yields is not true on this board until it
            // succeeds.
            ESP_LOGE(TAG, "the stored Ed25519 seed is still there: %s", esp_err_to_name(err));
        }
    }
    nvs_close(handle);
}

}  // namespace

bool SelfTest() {
    if (!EnsureSodium()) {
        return false;
    }
    using vectors::kSelfTestMessage;
    using vectors::kSelfTestPublicKey;
    using vectors::kSelfTestSignature;

    // A signature Python made, checked here.
    bool ok = crypto_sign_verify_detached(kSelfTestSignature,
                                          reinterpret_cast<const uint8_t *>(kSelfTestMessage),
                                          sizeof(kSelfTestMessage) - 1, kSelfTestPublicKey) == 0;

    // And one that must **not** verify, because a verifier that says yes to
    // everything also passes the line above. One flipped bit is the smallest
    // difference the scheme is allowed to miss, which makes it the right one.
    uint8_t tampered[kSignatureSize];
    std::memcpy(tampered, kSelfTestSignature, sizeof tampered);
    tampered[0] ^= 0x01;
    ok = ok && crypto_sign_verify_detached(tampered,
                                           reinterpret_cast<const uint8_t *>(kSelfTestMessage),
                                           sizeof(kSelfTestMessage) - 1,
                                           kSelfTestPublicKey) != 0;
    return ok;
}

esp_err_t Init() {
    EraseLegacySeed();

    if (!EnsureSodium()) {
        return ESP_ERR_NOT_SUPPORTED;
    }

    g_self_test_ok = SelfTest();
    if (!g_self_test_ok) {
        // **Loud, and it stops the device registering** (`responder::WhyNot`). A
        // board that cannot check §6's reply cannot know whose key it pinned, and
        // the failure mode of getting that wrong is trusting a handler that is not
        // the handler.
        ESP_LOGE(TAG, "libsodium fails its own vector - this device cannot verify the handler");
        return ESP_ERR_INVALID_STATE;
    }

    ESP_LOGI(TAG, "verifier ready (no private key on this device - §10.18)");
    return ESP_OK;
}

bool Ready() { return g_self_test_ok; }

const char *StateText() {
    return g_self_test_ok ? "ready - libsodium verifies against its own vector"
                          : "unusable - libsodium fails its vector; §6 replies cannot be checked";
}

bool Verify(const uint8_t public_key[kPublicKeySize], const uint8_t *message, size_t length,
            const uint8_t signature[kSignatureSize]) {
    if (!EnsureSodium() || public_key == nullptr || message == nullptr || signature == nullptr) {
        return false;
    }
    return crypto_sign_verify_detached(signature, message, length, public_key) == 0;
}

bool Base64Encode(const uint8_t *data, size_t length, char *out, size_t out_size) {
    if (data == nullptr || out == nullptr) {
        return false;
    }
    if (out_size < sodium_base64_ENCODED_LEN(length, sodium_base64_VARIANT_ORIGINAL)) {
        return false;
    }
    sodium_bin2base64(out, out_size, data, length, sodium_base64_VARIANT_ORIGINAL);
    return true;
}

size_t Base64Decode(const char *text, uint8_t *out, size_t out_size) {
    if (text == nullptr || out == nullptr) {
        return 0;
    }
    size_t written = 0;
    if (sodium_base642bin(out, out_size, text, std::strlen(text), nullptr, &written, nullptr,
                          sodium_base64_VARIANT_ORIGINAL) != 0) {
        return 0;
    }
    return written;
}

}  // namespace crypto
